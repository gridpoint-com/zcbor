## tests/encode/test1_suit/testcase.yaml
```yaml
tests:
  zcbor.encode.test1_suit.canonical:
    platform_allow:
      - native_sim
      - native_sim/native/64
      - mps2/an521/cpu0
      - qemu_malta/qemu_malta/be
    tags: zcbor encode canonical test1
    extra_args: CANONICAL=CANONICAL

  zcbor.encode.test1_suit.streaming_canonical:
    platform_allow:
      - native_sim
      - native_sim/native/64
      - mps2/an521/cpu0
      - qemu_malta/qemu_malta/be
    tags: zcbor encode streaming canonical test1
    extra_args: STREAMING=1 CANONICAL=CANONICAL
```

## tests/encode/test2_simple/testcase.yaml
```yaml
tests:
  zcbor.encode.test2_simple:
    platform_allow:
      - native_sim
      - native_sim/native/64
      - mps2/an521/cpu0
      - qemu_malta/qemu_malta/be
    tags: zcbor encode test

  zcbor.encode.test2_simple.streaming:
    platform_allow:
      - native_sim
      - native_sim/native/64
      - mps2/an521/cpu0
      - qemu_malta/qemu_malta/be
    tags: zcbor encode streaming test
    extra_args: STREAMING=1


  zcbor.encode.test2_simple.streaming_canonical:
    platform_allow:
      - native_sim
      - native_sim/native/64
      - mps2/an521/cpu0
      - qemu_malta/qemu_malta/be
    tags: zcbor encode streaming canonical test
    extra_args: STREAMING=1 CANONICAL=CANONICAL


  zcbor.encode.test2_simple.canonical:
    platform_allow:
      - native_sim
      - native_sim/native/64
      - mps2/an521/cpu0
      - qemu_malta/qemu_malta/be
    tags: zcbor encode canonical test
    extra_args: CANONICAL=CANONICAL
```

## tests/encode/test4_senml/testcase.yaml
```yaml
tests:
  zcbor.encode.test4_senml:
    platform_allow:
      - native_sim
      - native_sim/native/64
      - mps2/an521/cpu0
      - qemu_malta/qemu_malta/be
    tags: zcbor encode test4

  zcbor.encode.test4_senml.streaming:
    platform_allow:
      - native_sim
      - native_sim/native/64
      - mps2/an521/cpu0
      - qemu_malta/qemu_malta/be
    tags: zcbor encode streaming test4
    extra_args: STREAMING=1

  zcbor.encode.test4_senml.canonical:
    platform_allow:
      - native_sim
      - native_sim/native/64
      - mps2/an521/cpu0
      - qemu_malta/qemu_malta/be
    tags: zcbor encode canonical test4
    extra_args: CANONICAL=CANONICAL

  zcbor.encode.test4_senml.streaming_canonical:
    platform_allow:
      - native_sim
      - native_sim/native/64
      - mps2/an521/cpu0
      - qemu_malta/qemu_malta/be
    tags: zcbor encode streaming canonical test4
    extra_args: STREAMING=1 CANONICAL=CANONICAL
```

## tests/encode/test5_shared_type_iter/testcase.yaml
```yaml
tests:
  zcbor.encode.test5_shared_type_iter:
    platform_allow:
      - native_sim
      - native_sim/native/64
      - mps2/an521/cpu0
      - qemu_malta/qemu_malta/be
    tags: zcbor encode streaming test
```

## tests/encode/test6_iter_beyond_max_qty/testcase.yaml
```yaml
tests:
  zcbor.encode.test6_iter_beyond_max_qty:
    platform_allow:
      - native_sim
      - native_sim/native/64
      - mps2/an521/cpu0
      - qemu_malta/qemu_malta/be
    tags: zcbor encode streaming test
```
